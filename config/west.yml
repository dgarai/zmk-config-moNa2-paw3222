## config/west.yml
```yaml
manifest:
  # DYA Studio レベル2 対応（2026-11-18）
  # ZMK 本体を Custom Studio Protocol 対応の cormoran fork に差し替え、
  # DYA Studio 用モジュールを追加している。
  # 参考: https://github.com/cormoran/zmk-config-dya-studio-sample
  #       https://github.com/cormoran/zmk-keyboard-dya2/blob/main/config/west-dependency.yml
  defaults:
    remote: cormoran
    revision: main
  remotes:
    - name: zmkfirmware
      url-base: https://github.com/zmkfirmware
    - name: cormoran
      url-base: https://github.com/cormoran
    - name: caksoylar  # <-- RGB LED
      url-base: https://github.com/caksoylar
    - name: sekigon-gonnoc  # <-- PAW3222
      url-base: https://github.com/sekigon-gonnoc
    - name: gohanda11  # <-- Threshold Temp Layer
      url-base: https://github.com/gohanda11
  projects:
    # --- ZMK 本体（cormoran fork）と Zephyr ---------------------------------
    - name: zmk
      revision: main+dya
      import:
        file: app/west.yml
    - name: zephyr
      revision: v4.1.0+zmk-fixes+nrf-half-duplex-uart
      clone-depth: 1
      import:
        name-blocklist:
          - ci-tools
          - hal_altera
          - hal_cypress
          - hal_infineon
          - hal_microchip
          - hal_nxp
          - hal_openisa
          - hal_xtensa
          - hal_st
          - hal_ti
          - loramac-node
          - mcuboot
          - mcumgr
          - net-tools
          - openthread
          - edtt
          - trusted-firmware-m

    # --- コア -------------------------------------------------------------
    - name: zmk-feature-custom-settings
    - name: zmk-feature-fast-keymap

    # --- Keymap / Macro / Combo タブ ---------------------------------------
    - name: zmk-feature-runtime-macro
    - name: zmk-feature-runtime-combo
    - name: zmk-feature-input-stream
    - name: zmk-feature-module-physical-layout

    # --- Trackball タブ ----------------------------------------------------
    # PAW3222 用の Custom Studio RPC 対応ドライバは無いため sekigon 版をそのまま使う
    # （DYA Studio の Trackball タブのうち、センサー固有設定（CPI など）は未対応表示になる）
    - name: zmk-driver-paw3222
      remote: sekigon-gonnoc
      revision: main
    - name: zmk-module-runtime-input-processor
    # オートマウス（100 カウント動いてから MOUSE レイヤーへ）は従来どおり gohanda11 版
    - name: zmk-input-processor-threshold-temp-layer
      remote: gohanda11
      revision: main

    # --- Connection タブ ---------------------------------------------------
    - name: zmk-module-ble-management
    - name: zmk-feature-default-layer
      revision: codex/custom-rpc-rewrite
    - name: zmk-feature-os-detection

    # --- Settings タブ -----------------------------------------------------
    - name: zmk-module-settings-rpc

    # --- Troubleshooting タブ ----------------------------------------------
    - name: zmk-feature-device-info
    - name: zmk-feature-watchdog
    - name: zmk-feature-kscan-diagnostics

    # --- その他 -------------------------------------------------------------
    - name: zmk-rgbled-widget
      remote: caksoylar
      revision: main
  self:
    path: config
```
